## main/Kconfig.projbuild
```kconfig
menu "Configuração de rede wireless"
    config ESP_WIFI_SSID
        string "WiFi SSID"
        help
            Nome da rede Wifi.

    config ESP_WIFI_PASSWORD
        string "Senha do Wifi"
        help
            Senha do WiFi (WPA or WPA2).

    config ESP_MAXIMUM_RETRY
        int "Número máximo de tentativas de conexão"
        default 5
        help
            Número máximo de tentativas de conexão.
endmenu

menu "Configuração de chaves de acesso"
    config ESP_IPSTACK_KEY
        string "Chave de acesso ao serviço ipstack.com"
        help
            Chave de acesso ao serviço ipstack.com.
    
    config ESP_OPENWEATHER_KEY
        string "Chave de acesso ao serviço openweather.com"
        help
            Chave de acesso ao serviço openweather.com.
endmenu
```
